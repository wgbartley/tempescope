#include "application.h"

//SYSTEM_MODE(SEMI_AUTOMATIC);

//#include "neopixel.h"
//#define	PIXEL_COUNT		1
//#define	PIXEL_PIN		D2
//#define	PIXEL_TYPE		WS2812B
//Adafruit_NeoPixel strip = Adafruit_NeoPixel(PIXEL_COUNT, PIXEL_PIN, PIXEL_TYPE);

#include "elapsedMillis.h"
//elapsedMillis timer

#include "Adafruit_GFX.h"
#include "Adafruit_SSD1306.h"
Adafruit_SSD1306 display(D0);


// Function prototypes
void rainbow(uint8_t wait);
uint32_t Wheel(byte WheelPos);
void doDHT22();


// Controls
#define PIN_FOGGER	D5
#define PIN_PUMP	D6
#define PIN_FAN		A0

bool stateFogger = false;
bool statePump = false;
bool stateFan = false;


static const uint8_t particle[480] = {
	0B00000000, 0B00000000, 0B00000000, 0B00000000, 0B00000000, 0B00000000, 0B00000000, 0B00000000, 0B00000000, 0B00000000, 0B00000000, 0B00000000, 0B00000000, 0B00000000, 0B00000000, 0B00000000,
	0B00000000, 0B00000000, 0B00000000, 0B00000000, 0B00000000, 0B00000000, 0B00000000, 0B00000000, 0B00000000, 0B00000000, 0B00000000, 0B00000000, 0B00000000, 0B00000000, 0B00000000, 0B00000000,
	0B00000000, 0B00000011, 0B00000000, 0B00000000, 0B00000000, 0B00000000, 0B00000000, 0B00000000, 0B00000000, 0B00000000, 0B00000000, 0B00000000, 0B00000000, 0B00000000, 0B00000000, 0B00000000,
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	0B00000000, 0B00000000, 0B00000000, 0B00000000, 0B00000000, 0B00000000, 0B00000000, 0B00000000, 0B00000000, 0B00000000, 0B00000000, 0B00000000, 0B00000000, 0B00000000, 0B00000000, 0B00000000,
};


void setup() {
	//strip.begin();
	//strip.show();

	pinMode(D7, OUTPUT);
	digitalWrite(D7, HIGH);

	pinMode(PIN_FOGGER, OUTPUT);
	pinMode(PIN_PUMP, OUTPUT);
	pinMode(PIN_FAN, OUTPUT);

	doFogger();
	doPump();
	doFan();

	display.begin(SSD1306_SWITCHCAPVCC, 0x3C);  // initialize with the I2C addr 0x3D (for the 128x64)
	display.clearDisplay();

	display.setTextSize(2);
	display.setTextColor(WHITE);
	display.setCursor(0,0);
	display.println("Powered by");

	display.drawBitmap(0, 25, particle, 128, 30, WHITE);
	display.display();

	//Spark.connect();

	//if(!Spark.connected()) {
	//	Spark.process();
	//	rainbow(1);
	//}

	Spark.function("function", fnRouter);
	//Spark.subscribe("hook-response/get_weather_gov", doWeather, MY_DEVICES);

	delay(2000);
	displayStates();
	digitalWrite(D7, LOW);
}


void loop() {
	//rainbow(10);
}


void displayStates() {
	display.clearDisplay();
	display.setCursor(0, 0);
	display.println("Tempescope");

	display.setCursor(0, 16);
	display.println("Fogger");
	display.setCursor(88, 16);

	if(stateFogger)
		display.println(" On");
	else
		display.println("Off");


	display.setCursor(0, 32);
	display.println("Pump");
	display.setCursor(88, 32);

	if(statePump)
		display.println(" On");
	else
		display.println("Off");


	display.setCursor(0, 48);
	display.println("Fan");
	display.setCursor(88, 48);

	if(stateFan)
		display.println(" On");
	else
		display.println("Off");

	display.display();
}


int fnRouter(String command) {
	command.trim();
	command.toUpperCase();

	if(command.substring(0, 7)=="FOGGER,") {
		uint8_t onOff = command.substring(7).toInt();

		if(onOff==1)
			stateFogger = true;
		else
			stateFogger = false;

		doFogger();

		return stateFogger;

	} else if(command.substring(0, 5)=="PUMP,") {
		uint8_t onOff = command.substring(5).toInt();

		if(onOff==1)
			statePump = true;
		else
			statePump = false;

		doPump();

		return statePump;

	} else if(command.substring(0, 4)=="FAN,") {
		uint8_t onOff = command.substring(4).toInt();

		if(onOff==1)
			stateFan = true;
		else
			stateFan = false;

		doFan();

		return stateFan;
	}

    return -1;
}


void doFan() {
	if(stateFan)
		analogWrite(A0, 255);
	else
		analogWrite(A0, 0);

	displayStates();
}


void doPump() {
	if(statePump)
		digitalWrite(D6, HIGH);
	else
		digitalWrite(D6, LOW);

	displayStates();
}


void doFogger() {
	if(stateFogger)
		digitalWrite(D5, HIGH);
	else
		digitalWrite(D5, LOW);

	displayStates();
}


/* void rainbow(uint8_t wait) {
	uint16_t i, j;

	for(j=0; j<256; j++) {
		for(i=0; i<strip.numPixels(); i++)
			strip.setPixelColor(i, Wheel((i+j) & 255));

		strip.show();
		delay(wait);
	}
} */


// Input a value 0 to 255 to get a color value.
// The colours are a transition r - g - b - back to r.
/* uint32_t Wheel(byte WheelPos) {
	if(WheelPos < 85) {
		return strip.Color(WheelPos * 3, 255 - WheelPos * 3, 0);
	} else if(WheelPos < 170) {
		WheelPos -= 85;
		return strip.Color(255 - WheelPos * 3, 0, WheelPos * 3);
	} else {
		WheelPos -= 170;
		return strip.Color(0, WheelPos * 3, 255 - WheelPos * 3);
	}
} */